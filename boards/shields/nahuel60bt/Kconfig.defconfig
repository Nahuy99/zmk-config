## boards/shields/nahuel60bt/Kconfig.defconfig
```kconfig
if SHIELD_NAHUEL60BT
    
    config ZMK_KEYBOARD_NAME
        default "Nahuel 60 bt"

endif
```

## boards/shields/nahuel70split/Kconfig.defconfig
```kconfig
if SHIELD_NAHUEL70SPLIT_LEFT
    
    config ZMK_KEYBOARD_NAME
        default "Nahuel 70 Split"

    config ZMK_SPLIT_ROLE_CENTRAL
        default y

endif

if SHIELD_NAHUEL70SPLIT_RIGHT
    config ZMK_SPLIT_ROLE_CENTRAL
        default n
endif

if SHIELD_NAHUEL70SPLIT_LEFT || SHIELD_NAHUEL70SPLIT_RIGHT

    config ZMK_SPLIT
        default y

endif
```

## boards/shields/nahuel70split/Kconfig.shield
```kconfig
config SHIELD_NAHUEL70SPLIT_LEFT
    def_bool $(shields_list_contains,nahuel70split_left)

config SHIELD_NAHUEL70SPLIT_RIGHT
    def_bool $(shields_list_contains,nahuel70split_right)
```
