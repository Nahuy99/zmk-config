#include "nahuel70split.dtsi"

&default_transform {
    col-offset = <8>;
};

&kscan0 {
    col-gpios
        = <&gpio0 24 GPIO_ACTIVE_HIGH> // col 0
        , <&gpio1 0 GPIO_ACTIVE_HIGH> // col 1
        , <&gpio0 11 GPIO_ACTIVE_HIGH> // col 2
        , <&gpio1 4 GPIO_ACTIVE_HIGH> // col 3
        , <&gpio1 6 GPIO_ACTIVE_HIGH> // col 4
        , <&gpio0 9 GPIO_ACTIVE_HIGH> // col 5
        , <&gpio0 10 GPIO_ACTIVE_HIGH> // col 5
        , <&gpio0 22 GPIO_ACTIVE_HIGH> // col 6
        ;
};
